## boards/shields/zaphod/Kconfig.defconfig
```kconfig
# Copyright (c) 2020 The ZMK Contributors
# SPDX-License-Identifier: MIT

if SHIELD_ZAPHOD

config ZMK_KEYBOARD_NAME
    default "Zaphod"

endif # SHIELD_ZAPHOD
```

## boards/shields/zaphod/Kconfig.shield
```kconfig
# Copyright (c) 2021 The ZMK Contributors
# SPDX-License-Identifier: MIT

config SHIELD_ZAPHOD
   def_bool $(shields_list_contains,zaphod_lite)
```
